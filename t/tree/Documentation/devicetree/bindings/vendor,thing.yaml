## t/tree/Documentation/devicetree/bindings/vendor,thing.yaml
```yaml
# SPDX-License-Identifier: (GPL-2.0-only OR BSD-2-Clause)
%YAML 1.2
---
$id: http://devicetree.org/schemas/vendor,thing.yaml#
$schema: http://devicetree.org/meta-schemas/core.yaml#

title: Testproj thing

maintainers:
  - Testproj Maintainer <maintainer@example.com>

description: |
  Binding for the testproj thing. Describes a device whose driver matches
  with a compatible string.

properties:
  compatible:
    items:
      - const: "vendor,thing"

required:
  - compatible
```
